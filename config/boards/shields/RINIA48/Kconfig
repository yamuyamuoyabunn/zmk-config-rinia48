## config/boards/shields/RINIA48/Kconfig
```kconfig
if SHIELD_RINIA48_LEFT
    config ZMK_KEYBOARD_NAME
        default "RINIA48"
endif

if SHIELD_RINIA48_RIGHT
    config ZMK_KEYBOARD_NAME
        default "RINIA48"
endif
```

## config/boards/shields/RINIA48/Kconfig.shield
```kconfig
config SHIELD_RINIA48_LEFT
    def_bool $(shields_list_contains,RINIA48_left)

config SHIELD_RINIA48_RIGHT
    def_bool $(shields_list_contains,RINIA48_right)
```
